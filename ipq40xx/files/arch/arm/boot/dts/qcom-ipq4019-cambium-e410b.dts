// SPDX-License-Identifier: GPL-2.0-or-later OR MIT
/dts-v1/;

#include "qcom-ipq4019-cambium-sage.dtsi"

/ {
	model = "Cambium Networks E410B";
	compatible = "cambiumnetworks,e410b", "qcom,ipq4019";

	cambium-platform {
		compatible = "cambium-platform";
		board-sku = <21>;
	};
};

/* Keep the factory pre-calibration path and all other radios unchanged. */
&wifi1 {
	qcom,ath10k-calibration-variant = "Cambium-E410B-5G";
};
